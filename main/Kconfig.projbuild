## main/Kconfig.projbuild
```kconfig
menu "Xiaozhi Assistant"

config OTA_URL
    string "Default OTA URL"
    default "https://api.tenclass.net/xiaozhi/ota/"
    help
        The application will access this URL to check for new firmwares and server address.

config WIFI_CONNECT_TIMEOUT_SEC
    int "WiFi connect timeout before entering config mode (seconds)"
    default 60
    range 5 120
    help
        If the device cannot connect to the saved WiFi within this many
        seconds, it enters WiFi config mode. Lower values (e.g. 10) enter
        the provisioning page faster when the saved network is unreachable.

choice
    prompt "Flash Assets"
    default FLASH_DEFAULT_ASSETS if !USE_EMOTE_MESSAGE_STYLE
    default FLASH_EXPRESSION_ASSETS if USE_EMOTE_MESSAGE_STYLE
    help
        Select the assets to flash.

    config FLASH_NONE_ASSETS
        bool "Do not flash assets"
    config FLASH_DEFAULT_ASSETS
        bool "Flash Default Assets"
        depends on !USE_EMOTE_MESSAGE_STYLE
    config FLASH_CUSTOM_ASSETS
        bool "Flash Custom Assets"
    config FLASH_EXPRESSION_ASSETS
        bool "Flash Emote Assets"
        depends on USE_EMOTE_MESSAGE_STYLE
endchoice

config CUSTOM_ASSETS_FILE
    depends on FLASH_CUSTOM_ASSETS
    string "Custom Assets File"
    default "assets.bin"
    help
        The custom assets file to flash.
        It can be a local file relative to the project directory or a remote url.

choice
    prompt "Default Language"
    default LANGUAGE_ZH_CN
    help
        Select device display language

    config LANGUAGE_ZH_CN
        bool "Chinese"
    config LANGUAGE_ZH_TW
        bool "Chinese Traditional"
    config LANGUAGE_EN_US
        bool "English"
    config LANGUAGE_JA_JP
        bool "Japanese"
    config LANGUAGE_KO_KR
        bool "Korean"
    config LANGUAGE_VI_VN
        bool "Vietnamese"
    config LANGUAGE_TH_TH
        bool "Thai"
    config LANGUAGE_DE_DE
        bool "German"
    config LANGUAGE_FR_FR
        bool "French"
    config LANGUAGE_ES_ES
        bool "Spanish"
    config LANGUAGE_IT_IT
        bool "Italian"
    config LANGUAGE_RU_RU
        bool "Russian"
    config LANGUAGE_AR_SA
        bool "Arabic"
    config LANGUAGE_HI_IN
        bool "Hindi"
    config LANGUAGE_PT_PT
        bool "Portuguese"
    config LANGUAGE_PL_PL
        bool "Polish"
    config LANGUAGE_CS_CZ
        bool "Czech"
    config LANGUAGE_FI_FI
        bool "Finnish"
    config LANGUAGE_TR_TR
        bool "Turkish"
    config LANGUAGE_ID_ID
        bool "Indonesian"
    config LANGUAGE_UK_UA
        bool "Ukrainian"
    config LANGUAGE_RO_RO
        bool "Romanian"
    config LANGUAGE_BG_BG
        bool "Bulgarian"
    config LANGUAGE_CA_ES
        bool "Catalan"
    config LANGUAGE_DA_DK
        bool "Danish"
    config LANGUAGE_EL_GR
        bool "Greek"
    config LANGUAGE_FA_IR
        bool "Persian"
    config LANGUAGE_FIL_PH
        bool "Filipino"
    config LANGUAGE_HE_IL
        bool "Hebrew"
    config LANGUAGE_HR_HR
        bool "Croatian"
    config LANGUAGE_HU_HU
        bool "Hungarian"
    config LANGUAGE_MS_MY
        bool "Malay"
    config LANGUAGE_NB_NO
        bool "Norwegian"
    config LANGUAGE_NL_NL
        bool "Dutch"
    config LANGUAGE_SK_SK
        bool "Slovak"
    config LANGUAGE_SL_SI
        bool "Slovenian"
    config LANGUAGE_SV_SE
        bool "Swedish"
    config LANGUAGE_SR_RS
        bool "Serbian"
endchoice

choice BOARD_TYPE
    prompt "Target Board"
    # All remaining products are ESP32-S3 toys.
    default BOARD_TYPE_WZH_CRAWLPANDA if IDF_TARGET_ESP32S3
    help
        Select the physical board hardware implementation.
        The OTA board type and firmware variant name are configured separately.

    config BOARD_TYPE_WZH_CRAWLPANDA
        bool "WZH Crawl Panda"
        depends on IDF_TARGET_ESP32S3
    config BOARD_TYPE_WZH_DINOSAUR
        bool "WZH Dinosaur"
        depends on IDF_TARGET_ESP32S3
    config BOARD_TYPE_WZH_TAILREDPANDA
        bool "WZH Tail Red Panda"
        depends on IDF_TARGET_ESP32S3
endchoice

choice DISPLAY_STYLE
    prompt "Select display style"
    default USE_DEFAULT_MESSAGE_STYLE
    help
        Select the chat message display style.

    config USE_DEFAULT_MESSAGE_STYLE
        bool "Enable default message style"

    config USE_WECHAT_MESSAGE_STYLE
        bool "Enable WeChat Message Style"

    config USE_EMOTE_MESSAGE_STYLE
        bool "Emote animation style"
endchoice

config USE_MULTILINE_CHAT_MESSAGE
    bool "Use multiline chat message display (default mode only)"
    depends on USE_DEFAULT_MESSAGE_STYLE
    default n
    help
        When enabled, the chat message area in the default display mode shows
        multiple wrapped lines that grow upward from the bottom of the screen,
        with auto-adaptive height.
        When disabled (default), a single-line horizontally scrolling label
        is shown at the bottom of the screen.

choice WAKE_WORD_TYPE
    prompt "Wake Word Implementation Type"
    default USE_AFE_WAKE_WORD if (IDF_TARGET_ESP32S3 || IDF_TARGET_ESP32P4 || IDF_TARGET_ESP32S31) && SPIRAM
    default WAKE_WORD_DISABLED
    help
        Choose the type of wake word implementation to use

    config WAKE_WORD_DISABLED
        bool "Disabled"
        help
            Disable wake word detection

    config USE_ESP_WAKE_WORD
        bool "Wakenet model without AFE"
        depends on IDF_TARGET_ESP32C3 || IDF_TARGET_ESP32C5 || IDF_TARGET_ESP32C6 || (IDF_TARGET_ESP32 && SPIRAM)
        help
            Support ESP32 C3、ESP32 C5 与 ESP32 C6, and (ESP32 with PSRAM)

    config USE_AFE_WAKE_WORD
        bool "Wakenet model with AFE"
        depends on (IDF_TARGET_ESP32S3 || IDF_TARGET_ESP32P4 || IDF_TARGET_ESP32S31) && SPIRAM
        help
            Support AEC if available, requires ESP32-S3, ESP32-P4, or ESP32-S31 and PSRAM

    config USE_CUSTOM_WAKE_WORD
        bool "Multinet model (Custom Wake Word)"
        depends on (IDF_TARGET_ESP32S3 || IDF_TARGET_ESP32P4 || IDF_TARGET_ESP32S31) && SPIRAM
        help
            Requires ESP32-S3, ESP32-P4, or ESP32-S31 and PSRAM

endchoice

config WZH_ALLOW_CROSS_PRODUCT_WAKE_MODEL
    bool "Allow another WZH product's wake phrase"
    depends on USE_AFE_WAKE_WORD && (BOARD_TYPE_WZH_DINOSAUR || BOARD_TYPE_WZH_CRAWLPANDA || BOARD_TYPE_WZH_TAILREDPANDA)
    default n
    help
        Allow an intentionally selected wake model normally used by another
        WZH product. Keep disabled to catch stale menuconfig settings when
        switching products in the IDE. Other custom models are unaffected.

config WZH_OFFLINE_COMMANDS
    bool "WZH local motion keywords"
    depends on (BOARD_TYPE_WZH_DINOSAUR || BOARD_TYPE_WZH_CRAWLPANDA || BOARD_TYPE_WZH_TAILREDPANDA) && (USE_CUSTOM_WAKE_WORD || USE_AFE_WAKE_WORD)
    default y
    help
        Package local motion commands with the Chinese MultiNet model.
        Commands share the AFE output with WakeNet or a custom wake phrase.
        The board handles them locally, without opening a network session.

config WZH_OFFLINE_COMMAND_THRESHOLD
    int "WZH local keyword threshold (%)"
    depends on WZH_OFFLINE_COMMANDS
    default 50
    range 1 99
    help
        Recognition threshold for local commands when WakeNet handles wake-up.
        A higher value reduces false triggers; it does not change WakeNet sensitivity.

config CUSTOM_WAKE_WORD
    string "Custom Wake Word"
    default "xiao tu dou"
    depends on USE_CUSTOM_WAKE_WORD
    help
        Custom Wake Word, use pinyin for Chinese, separated by spaces

config CUSTOM_WAKE_WORD_DISPLAY
    string "Custom Wake Word Display"
    default "小土豆"
    depends on USE_CUSTOM_WAKE_WORD
    help
        Greeting sent to the server after wake word detection

config CUSTOM_WAKE_WORD_THRESHOLD
    int "Custom Wake Word Threshold (%)"
    default 20
    range 1 99
    depends on USE_CUSTOM_WAKE_WORD
    help
        Custom Wake Word Threshold, range 1-99, the smaller the more sensitive, default 20

config SEND_WAKE_WORD_DATA
    bool "Send Wake Word Data"
    default y
    depends on USE_AFE_WAKE_WORD || USE_CUSTOM_WAKE_WORD
    help
        Send wake word data to the server as the first message of the conversation and wait for response

config WAKE_WORD_DETECTION_IN_LISTENING
    bool "Enable Wake Word Detection in Listening Mode"
    default n
    depends on USE_AFE_WAKE_WORD || USE_CUSTOM_WAKE_WORD
    help
        Enable wake word detection while in listening mode.
        When enabled, the device can detect wake word during listening,
        which allows interrupting the current conversation.
        When disabled (default), wake word detection is turned off during listening.

config USE_AUDIO_PROCESSOR
    bool "Enable AFE Audio Processing"
    default y
    depends on (IDF_TARGET_ESP32S3 || IDF_TARGET_ESP32P4 || IDF_TARGET_ESP32S31) && SPIRAM
    help
        Enable the shared AFE uplink path with AEC and VAD. Noise suppression
        is optional in the experimental neural voice-interruption frontend.
        Requires ESP32-S3, ESP32-P4, or ESP32-S31 with PSRAM.

config USE_SERVER_AEC
    bool "Enable Server-Side AEC (Unstable)"
    default n
    depends on USE_AUDIO_PROCESSOR
    help
        To work perperly, server-side AEC requires server support

config USE_VOICE_BARGE_IN
    bool "Experimental local voice interruption with playback reference"
    default n
    depends on USE_AUDIO_PROCESSOR && USE_AFE_WAKE_WORD && !USE_SERVER_AEC
    help
        Detect sustained post-AEC speech during a reply and interrupt locally.
        Requires a codec providing microphone plus playback-reference channels.
        Uses auto listening and the server's standard STT-before-TTS ordering.
        Enabled by the dedicated WZH crawl-panda, dinosaur and tail-red-panda
        barge-in test variants. Ordinary variants keep it disabled.

config AUDIO_PRODUCT_QUALITY
    bool "Product audio quality: capture, container timing and smooth endings"
    default n
    depends on IDF_TARGET_ESP32S3 && SPIRAM
    help
        Use 32 kbps / complexity 3 microphone encoding and quality 3 capture
        resampling. Preserve local Opus preskip, end trim and header gain;
        reset independent streams and finish playback with a short smooth tail.
        Does not change the official service's downlink bitrate or codec volume.

config AUDIO_SPEAKER_VOICE_CLARITY
    bool "Speech clarity profile for protected small speakers"
    default n
    help
        Optional pre-DAC speech EQ and a 5 ms startup ramp. Applies only when
        the board enables speaker protection. The loudness guard precedes
        the peak limiter so their gains do not unnecessarily compound.
        Does not change the codec volume, clocks or microphone processing.

config AUDIO_SPEAKER_SMOOTH_LIMITER
    bool "Smooth protected speaker attacks for music and speech"
    default n
    depends on AUDIO_SPEAKER_VOICE_CLARITY
    help
        Smooth gain over the existing 1 ms look-ahead window to reduce sudden
        gain changes on music transients. Preserves the original peak ceiling,
        RMS guard, codec volume and output rate. Also logs decoded Opus quality
        statistics without recording or sending audio.

config VOICE_BARGE_IN_NEURAL_FRONTEND
    bool "NSNet2 and lightweight VAD after full-duplex AEC (experimental)"
    default n
    depends on USE_VOICE_BARGE_IN && SPIRAM
    depends on IDF_TARGET_ESP32S3 || IDF_TARGET_ESP32P4 || IDF_TARGET_ESP32S31
    depends on SR_NSN_NSNET2
    help
        Process post-AEC mono through NSNet2 and then WebRTC VAD before interruption
        detection. Requires NSNet2 in the assets. Extra latency, CPU and
        memory must be measured on the device. Does not change speaker volume.

config WZH_DINO_KEYWORD_BARGE_IN
    bool "WZH keyword-confirmed voice interruption"
    depends on (BOARD_TYPE_WZH_DINOSAUR || BOARD_TYPE_WZH_CRAWLPANDA || BOARD_TYPE_WZH_TAILREDPANDA) && USE_VOICE_BARGE_IN && WZH_OFFLINE_COMMANDS
    depends on !VOICE_BARGE_IN_NEURAL_FRONTEND && !VOICE_BARGE_IN_VADNET_EXPERIMENT
    default n
    help
        Require a locally recognized interruption command as well as a recent
        near-end voice candidate before interrupting playback. This is a
        fixed-vocabulary test; ordinary speech alone will not interrupt. The
        historical configuration name is retained for existing variants.

config WZH_DINOSAUR_MOTION_BARGE_GUARD
    bool "Experimental dinosaur movement-aware interruption duration"
    default n
    depends on BOARD_TYPE_WZH_DINOSAUR && USE_VOICE_BARGE_IN
    help
        Require 300 ms rather than 180 ms of VAD when a recent servo movement
        command is present. This is a heuristic and may miss short speech.
        It does not provide server transcript confirmation.

config VOICE_BARGE_IN_VADNET_EXPERIMENT
    bool "Experimental AFE VADNet interruption detector"
    default n
    depends on USE_VOICE_BARGE_IN && SR_VADN_VADNET1_MEDIUM
    depends on !VOICE_BARGE_IN_NEURAL_FRONTEND
    depends on IDF_TARGET_ESP32S3
    help
        Use AFE VADNet without the NSNet2 uplink frontend. This is an
        unvalidated comparison and does not transcribe speech. It changes
        uplink denoising; verify load, audio quality, wake and interruption.

config WZH_DINO_OFFICIAL_ASR_PROBE
    bool "Dinosaur official-service ASR probe (diagnostic only)"
    default n
    depends on BOARD_TYPE_WZH_DINOSAUR && VOICE_BARGE_IN_VADNET_EXPERIMENT
    help
        Once per boot, send a bounded speech candidate to the current official
        service without locally aborting the ongoing playback. This experiment
        can change the server conversation; it is not a product interruption
        mode and does not guarantee the original reply survives.

config USE_AUDIO_DEBUGGER
    bool "Enable Audio Debugger"
    default n
    help
        Enable audio debugger, send audio data through UDP to the host machine

config AUDIO_DEBUG_PACKETIZED
    bool "Tag raw and processed audio debug packets"
    depends on USE_AUDIO_DEBUGGER
    default n
    help
        Send versioned packets with sequence, sample position and format.
        Includes processed AFE output. Legacy raw-only UDP remains the default.

config AUDIO_DEBUG_DURATION_SECONDS
    int "Maximum packetized capture duration (seconds)"
    depends on AUDIO_DEBUG_PACKETIZED
    range 5 120
    default 60
    help
        Stop sending after this interval from the first successful UDP send.

config VOICE_BARGE_IN_SHADOW
    bool "Observe voice interruption without aborting playback"
    depends on USE_VOICE_BARGE_IN && AUDIO_DEBUG_PACKETIZED
    default n
    help
        Diagnostic only: record complete playback and near-end audio without
        letting an unverified interruption candidate cancel playback.

menu "WiFi Configuration Method"
    help
        WiFi Configuration Method Selection
    config USE_HOTSPOT_WIFI_PROVISIONING
        bool "Hotspot"
        default y
        help
            Use WiFi Hotspot to transmit WiFi configuration data
    config USE_ESP_BLUFI_WIFI_PROVISIONING
        bool "ESP-BluFi"
        select BT_ENABLED
        select BT_BLE_42_FEATURES_SUPPORTED
        select BT_BLE_BLUFI_ENABLE
        help
            Use the PSA Crypto based BluFi security protocol adopted by ESP-IDF 6.
            The provisioning client must support ffdhe3072, SHA-256, and AES-CTR.
endmenu

config AUDIO_DEBUG_UDP_SERVER
    string "Audio Debug UDP Server Address"
    default "192.168.2.100:8000"
    depends on USE_AUDIO_DEBUGGER
    help
        UDP server address, format: IP:PORT, used to receive audio debugging data

config RECEIVE_CUSTOM_MESSAGE
    bool "Enable Custom Message Reception"
    default n
    help
        Enable custom message reception, allow the device to receive custom messages from the server (preferably through the MQTT protocol)

menu "Camera Configuration"
    depends on !IDF_TARGET_ESP32

    comment "Warning: Please read the help text before modifying these settings."

    config XIAOZHI_CAMERA_ALLOW_JPEG_INPUT
        bool "Allow JPEG Input"
        default n
        help
            Allow JPEG Input format for the camera.

            This option may need to be enabled when using a USB camera.

            Not currently supported when used simultaneously with XIAOZHI_ENABLE_ROTATE_CAMERA_IMAGE.

    config XIAOZHI_ENABLE_HARDWARE_JPEG_ENCODER
        bool "Enable Hardware JPEG Encoder"
        default y
        depends on SOC_JPEG_ENCODE_SUPPORTED
        help
            Use hardware JPEG encoder on ESP32-P4 to encode image to JPEG.
            See https://docs.espressif.com/projects/esp-idf/en/stable/esp32p4/api-reference/peripherals/jpeg.html for more details.

    config XIAOZHI_ENABLE_HARDWARE_JPEG_DECODER
        bool "Enable Hardware JPEG Decoder"
        default n
        depends on SOC_JPEG_DECODE_SUPPORTED && XIAOZHI_CAMERA_ALLOW_JPEG_INPUT
        help
            Use hardware JPEG decoder on ESP32-P4 to decode JPEG to image.
            See https://docs.espressif.com/projects/esp-idf/en/stable/esp32p4/api-reference/peripherals/jpeg.html for more details.

    config XIAOZHI_ENABLE_CAMERA_DEBUG_MODE
        bool "Enable Camera Debug Mode"
        default n
        help
            Enable camera debug mode, print camera debug information to the console.
            Only works on boards that support camera.

    config XIAOZHI_ENABLE_CAMERA_ENDIANNESS_SWAP
        bool "Enable software camera buffer endianness swapping"
        default n
        depends on !CAMERA_SENSOR_SWAP_PIXEL_BYTE_ORDER
        help
            This option treats the camera buffer as a uint16_t[] array and performs byte-swapping (endianness conversion) on each element.

            Should only be modified by development board integration engineers.

            **Incorrect usage may result in incorrect image colors!**

            ATTENTION: If the option CAMERA_SENSOR_SWAP_PIXEL_BYTE_ORDER is available for your sensor, please use that instead.

    menuconfig XIAOZHI_ENABLE_ROTATE_CAMERA_IMAGE
        bool "Enable Camera Image Rotation"
        default n
        depends on !XIAOZHI_CAMERA_ALLOW_JPEG_INPUT
        help
            Enable camera image rotation, rotate the camera image to the correct orientation.
            - On ESP32-P4, rotation is handled by PPA hardware.
            - On other chips, rotation is done in software with performance cost.
            - For 180° rotation, use HFlip + VFlip instead of this option.

            Not currently supported when used simultaneously with XIAOZHI_CAMERA_ALLOW_JPEG_INPUT.

    if XIAOZHI_ENABLE_ROTATE_CAMERA_IMAGE
        choice XIAOZHI_CAMERA_IMAGE_ROTATION_ANGLE
            prompt "Camera Image Rotation Angle (clockwise)"
            default XIAOZHI_CAMERA_IMAGE_ROTATION_ANGLE_90
            help
                Camera image rotation angle.
            config XIAOZHI_CAMERA_IMAGE_ROTATION_ANGLE_90
                bool "90°"
            config XIAOZHI_CAMERA_IMAGE_ROTATION_ANGLE_270
                bool "270°"
            comment "For 180° rotation, use HFlip + VFlip instead of this option"
        endchoice
    endif
endmenu

menu "TAIJIPAI_S3_CONFIG"
    depends on BOARD_TYPE_TAIJI_PI_S3
    choice I2S_TYPE_TAIJIPI_S3
        prompt "taiji-pi-S3 I2S Type"
        default TAIJIPAI_I2S_TYPE_STD
        help
            I2S 类型选择
        config TAIJIPAI_I2S_TYPE_STD
            bool "I2S Type STD"
        config TAIJIPAI_I2S_TYPE_PDM
            bool "I2S Type PDM"
    endchoice

    config I2S_USE_2SLOT
    bool "Enable I2S 2 Slot"
    default y
    help
        启动双声道
endmenu

menu "WZH Product Configuration"
    depends on BOARD_TYPE_WZH_CRAWLPANDA || BOARD_TYPE_WZH_DINOSAUR || BOARD_TYPE_WZH_TAILREDPANDA

    choice WZH_FLASH_TYPE
        prompt "External audio flash type"
        default WZH_FLASH_AUTO_DETECT
        help
            三款产品默认搭载 W25N01GV SPI NAND（128MB）。以开机日志中的
            JEDEC ID 为准（NAND: EF AA 21；NOR: EF 40/60 xx）。个别批次
            若换成 NOR，可在真机确认后在此强制指定。
        config WZH_FLASH_AUTO_DETECT
            bool "Auto detect (JEDEC ID)"
            help
                运行时读取 JEDEC ID 自动选择 NOR/NAND 驱动。
        config WZH_FLASH_FORCE_NAND
            bool "Force W25N01GV (SPI NAND)"
            help
                跳过探测，直接按 NAND 初始化；芯片不符时初始化失败。
        config WZH_FLASH_FORCE_NOR
            bool "Force W25Q256-class (SPI NOR)"
            help
                跳过探测，直接按 NOR 初始化；芯片不符时初始化失败。
    endchoice

    config WZH_SYSTEM_PROMPTS
        bool "Use a prepared product system-voice pack"
        depends on LANGUAGE_ZH_CN
        default n
        help
            内置离线产品播报：恐龙使用 dinosaur 音包，两款熊猫共用 panda 音包。
            先用 scripts/audio/prepare_wzh_system_prompts.py 制作完整音包。
            默认关闭；素材缺失或未确认音色时不会偷偷替换现有声音。

    config WZH_SYSTEM_PROMPT_ROOT
        string "Prepared system-voice pack root (relative to project or absolute)"
        depends on WZH_SYSTEM_PROMPTS
        default "main/assets/wzh_system_voices"

    config WZH_SYSTEM_PROMPT_ALLOW_ALTERNATIVE
        bool "Allow explicitly selected alternative voices (e.g. Edge preview)"
        depends on WZH_SYSTEM_PROMPTS
        default n
        help
            Edge 的云希/晓晓不等于阳光青年/樱桃丸子。仅在接受替代声音后开启。
            此选项不改变云端角色音色，也不代表获得音色的商用许可。

    config WZH_AUDIO_SYNC_ENABLE
        bool "Enable Audio Hub background sync"
        default n
        help
            默认关闭：设备开机和运行期间不主动连接 Audio Hub。
            后续可由设备网页控制台按需检查清单、选择并更新音频；
            关闭时设备完整离线运行（对话与本地声音不受影响）。

    config WZH_AUDIO_SYNC_SERVER
        string "Audio Hub server base URL"
        default "http://192.168.1.7:5000"
        help
            Audio Hub 服务地址（老工程硬编码 192.168.1.7:5000）。
            可通过 NVS（audio_hub 命名空间，server 键）覆盖，无需重烧固件。

    menu "WZH idle countdown"
        config WZH_IDLE_POWER_ENABLE
            bool "Enable the no-interaction countdown"
            default n
            help
                灰度总开关。开启后：5 分钟无人互动播一句「想你」并让 idle
                音效静默（动作幅度不变），10 分钟播现成 OGG_POWER_OFF 后关机。
                平时每 2-3 分钟一次动作+音频展示，对话期间计时永不推进。
                默认关闭，真机实测后再打开。

        config WZH_IDLE_AUTO_OFF
            bool "Shut down after 10 minutes without interaction"
            depends on WZH_IDLE_POWER_ENABLE
            default y
            help
                10 分钟无人互动自动关机，复用长按关机的完整流程（含关机音）。
                关机后必须长按电源键 1 秒才能再开机。

        config WZH_IDLE_MISS_PROMPT
            bool "Say one idle-miss sentence at 5 minutes"
            depends on WZH_IDLE_POWER_ENABLE
            default y
            help
                5 分钟无人互动播 OGG_IDLE_MISS（「想你」），播完或跳过之后
                idle 音效静默，动作照做、幅度不变，直到 10 分钟关机。

        config WZH_IDLE_DROP_AP
            bool "Stop the provisioning hotspot while idle"
            depends on WZH_IDLE_POWER_ENABLE
            default n
            help
                保持关闭：热点全程常驻，随时可配网。开启会让关机前
                无法连接门户。

        config WZH_IDLE_DROP_WAKENET
            bool "Disable wake word while idle"
            depends on WZH_IDLE_POWER_ENABLE
            default n
            help
                保持关闭：关机前随时能喊名字，关了只会让人以为坏了。
    endmenu
endmenu

endmenu
```
